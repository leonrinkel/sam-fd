/* SPDX-License-Identifier: MIT */
/**
 * \file      src/main.c
 * \brief     Main application logic
 * \copyright Copyright (c) 2023 Leon Rinkel
 */

#include <stdbool.h>

#include <drv/can.h>
#include <drv/flash.h>
#include <drv/uart.h>

#include <reg/can.h>
#include <reg/dsu.h>
#include <reg/port.h>

#include <main.h>

static const uint8_t some_data[256] =
{
	0xABu, 0x14u, 0xF8u, 0xC8u, 0x04u, 0x8Eu, 0xF1u, 0xEFu, 0xD2u, 0x05u, 0xD3u, 0x49u, 0x81u, 0x5Bu, 0xDEu, 0x75u,
	0x97u, 0x17u, 0x9Bu, 0xAEu, 0x33u, 0x2Bu, 0x0Bu, 0x5Eu, 0xFCu, 0x37u, 0x68u, 0x8Cu, 0x06u, 0x4Cu, 0xE6u, 0x04u,
	0x14u, 0x76u, 0x63u, 0x5Cu, 0x40u, 0x8Du, 0xA7u, 0x9Au, 0xC0u, 0xB7u, 0xB0u, 0xDFu, 0xE4u, 0x50u, 0xE8u, 0x01u,
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	0x82u, 0x27u, 0xA9u, 0xC4u, 0x5Cu, 0x06u, 0x44u, 0xA1u, 0x59u, 0x2Au, 0x70u, 0xE5u, 0x25u, 0xB9u, 0x6Fu, 0x40u,
};

/** \brief Main function */
int main(void)
{
	while (true)
	{
		__asm__("nop");
	}

	return 0;
}

void task_1ms(void)
{
	uint8_t cmd[2];
	uint32_t crc;

	if (uart_available() == 2)
	{
		if (uart_read(cmd, 2) != 2)
		{
			return;
		}

		if (cmd[0] == 'u' && cmd[1] == 'a')
		{
			uart_write((uint8_t*) " pressed a ", 12);
		}
		else if (cmd[0] == 'f' && cmd[1] == 'e')
		{
			/* Test erasing flash */
			if (flash_erase_row(0xF00u))
			{
				uart_write((uint8_t*) " ok ", 5);
			}
			else
			{
				uart_write((uint8_t*) " nok ", 6);
			}
		}
		else if (cmd[0] == 'f' && cmd[1] == 'w')
		{
			/* Test writing flash */
			if (flash_write_row(0xF00u, some_data))
			{
				uart_write((uint8_t*) " ok ", 5);
			}
			else
			{
				uart_write((uint8_t*) " nok ", 6);
			}
		}
		else if (cmd[0] == 'h' && cmd[1] == 'c')
		{
			/* Test hardware accelerated CRC */

			/* Start CRC calculation */
			DSU_ADDR.U =
				(uint32_t) some_data |
				(0x0u << DSU_ADDR_AMOD_OFF);
			DSU_LENGTH.U = 256u;
			DSU_DATA = 0xFFFFFFFFu; /* Initial value */
			DSU_CTRL.U = DSU_CTRL_CRC_MSK;

			/* Wait till CRC finished */
			while (!DSU_STATUSA.B.DONE);
			DSU_STATUSA.U = DSU_STATUSA_DONE_MSK;

			crc = DSU_DATA ^ 0xFFFFFFFFu; /* Final XOR value */
			if (crc == 0x8E663A3Du)
			{
				uart_write((uint8_t*) " ok ", 5);
			}
			else
			{
				uart_write((uint8_t*) " nok ", 6);
			}
		}
	}
}

void task_10ms(void)
{
	/* UART transmit */
	uart_write((uint8_t*) "yo", 2);
}

void task_100ms(void)
{
	static uint8_t cycle = 0;

	if (PORT_IN.B.IN8)
	{
		/* Toggle TX_ACT/RX_ACT LEDs */
		PORT_OUT.U ^= PORT_DIR_DIR9_MSK;
		PORT_OUT.U ^= PORT_DIR_DIR10_MSK;
	}

	/* Fill CAN TX buffer 0 */
	can_tx_buffer[0].U[0] =
		(0x123u << CAN_TX_BUFFER_STD_ID_OFF);
	can_tx_buffer[0].U[1] =
		(0x3u << CAN_TX_BUFFER_DLC_OFF);
	can_tx_buffer[0].B.DB[0] = cycle;
	can_tx_buffer[0].B.DB[1] = cycle;
	can_tx_buffer[0].B.DB[2] = cycle++;

	/* Transmit message */
	CAN0_TXBAR = 0x1u << 0;
}

void task_1000ms(void)
{
	if (!PORT_IN.B.IN8)
	{
		/* Toggle TX_ACT/RX_ACT LEDs */
		PORT_OUT.U ^= PORT_DIR_DIR9_MSK;
		PORT_OUT.U ^= PORT_DIR_DIR10_MSK;
	}

	/* UART transmit */
	uart_write((uint8_t*) " hello ", 8);
}
